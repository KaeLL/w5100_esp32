## Kconfig
```kconfig
menu "W5100 configurations"
    config W5100_RESET_GPIO
        int "/RESET pin's GPIO number"
        default 12
        help
            GPIO connected to W5100's /RESET pin.

    config W5100_SPI_EN_MANUAL
        bool "MCU must drive SPI_EN pin"
        default y
        help
            Enable this in case the ESP32 must drive W5100's SPI_EN pin.
            Needed if the W5100 shares the SPI bus with another device.

    config W5100_SPI_EN_GPIO
        depends on W5100_SPI_EN_MANUAL
        int "SPI_EN pin's GPIO number"
        default 22

    config W5100_SPI_CLCK
        int "SPI clock speed (hz)"
        default 300000
        help
            Clock speed that should be used to communicate with W5100.

    config EMAC_RECV_TASK_ENABLE_CORE_AFFINITY
        bool "Enable W5100 recv task core selection"
        default y
        help
            Enable this to manually set W5100's recv task affinity. May be needed
            in order to balance load across cores depending on workload.
            Leave it disabled for no affinity.

    config EMAC_RECV_TASK_CORE
        depends on EMAC_RECV_TASK_ENABLE_CORE_AFFINITY
        int "Which core?"
        range 0 1
        default 1
        help
            Select the core to pin the task to
            0 - PRO CPU
            1 - APP CPU

    config EMAC_ENABLE_RECV_TASK_DELAY
        bool "Enable RX task delay"
        default y
        help
            Enable the use of a delay at the end of the recv task to prevent
            it from monopolizing SPI. May be needed when there are other
            peripherals on the same SPI bus, especially if they're
            time-sensitive.

    config EMAC_DELAY_TICKS
        depends on EMAC_ENABLE_RECV_TASK_DELAY
        int "Number of ticks to delay"
        default 1

    config W5100_SPI_BUS_ACQUIRE
        bool "Enable bus acquiring"
        help
            This allows the SPI driver to assume all transactions will be directed to
            the same device, optimizing transactions and executing them in a back to back
            fashion. Only enable it if W5100 is the only device in the SPI bus.

    config W5100_CS
        int "W5100 CS GPIO"
        default 17
        help
            GPIO connected to W5100's Slave Select line

    config W5100_SPI_LOCK
        bool "Enable driver locks"
        help
            Enable/disable locks around each SPI transaction.
            Only disable it if you're providing your own synchronization.

    config W5100_SPI_BUS
        int "SPI bus"
        default 3
        help
            SPI bus to be used.
            1 = SPI_HOST
            2 = HSPI_HOST
            3 = VSPI_HOST
            Only select 1 if you know what you're doing. Check SPI Master documentation
            for more info.

    config W5100_USE_CUSTOM_TRANS_FUNCTION
        bool "Use custom SPI transaction wrapper"
        default y
        help
            Enable this to provide your own wrapper over the spi_device(_polling)transmit
            functions. In practice, this is so a wrapper over transactions with a SPI-bus-wide
            lock can be provided.

            Refer to: https://github.com/espressif/esp-idf/issues/5517
endmenu
```
